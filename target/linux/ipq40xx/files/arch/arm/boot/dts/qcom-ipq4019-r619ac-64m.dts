// SPDX-License-Identifier: GPL-2.0-or-later OR MIT

#include "qcom-ipq4019-r619ac.dtsi"

/ {
	model = "P&W R619AC 64M";
	compatible = "p2w,r619ac-64m";

	chosen {
		bootargs-append = " ubi.mtd=ubi root=/dev/ubiblock0_1";
	};
};

&nand_rootfs {
	reg = <0x0 0x4000000>;
};
